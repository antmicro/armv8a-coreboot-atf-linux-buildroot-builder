## buildroot-configs/cortex-a75_defconfig
```kconfig
BR2_aarch64=y
BR2_cortex_a75=y
BR2_KERNEL_HEADERS_CUSTOM_TARBALL=y
BR2_KERNEL_HEADERS_CUSTOM_TARBALL_LOCATION="https://github.com/torvalds/linux/archive/refs/tags/v6.3.tar.gz"
BR2_PACKAGE_HOST_LINUX_HEADERS_CUSTOM_6_3=y
BR2_PACKAGE_PYTHON3=y
# BR2_PACKAGE_PYTHON3_UNICODEDATA is not set
BR2_PACKAGE_OPENSSL=y
BR2_PACKAGE_LIBOPENSSL_BIN=y
# BR2_PACKAGE_IFUPDOWN_SCRIPTS is not set
# BR2_PACKAGE_URANDOM_SCRIPTS is not set
BR2_TARGET_ROOTFS_CPIO=y
# BR2_TARGET_ROOTFS_TAR is not set
```

## coreboot_defconfig
```kconfig
CONFIG_LINUX_COMMAND_LINE="console=ttyAMA0,115200"
CONFIG_VENDOR_EMULATION=y
CONFIG_MAINBOARD_VENDOR="Emulation"
CONFIG_CBFS_SIZE=0x04000000
CONFIG_BOARD_EMULATION_QEMU_AARCH64=y
CONFIG_COREBOOT_ROMSIZE_KB_65536=y
CONFIG_COREBOOT_ROMSIZE_KB=65536
CONFIG_ROM_SIZE=0x04000000

# PAYLOAD_NONE=y is a default since Coreboot v4.19 (ffc79fb)
# except for x86. PAYLOAD_FIT/FILE options are ignored then.
CONFIG_PAYLOAD_NONE=n
CONFIG_PAYLOAD_FIT_SUPPORT=y
CONFIG_PAYLOAD_FIT=y
CONFIG_PAYLOAD_FILE="uImage"
```
